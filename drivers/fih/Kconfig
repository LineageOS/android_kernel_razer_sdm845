## drivers/fih/Kconfig
```kconfig
#
# fih driver
#

menu "fih driver"

config FIH
	bool "fih"
	default n
	help
	  support fih


config FIH_RC2
	bool "fih_rc2"
	default n
	help
	  support fih_rc2

config FIH_APR
	bool "fih apr"
	depends on FIH
	default n
	help
	  support fih apr virtual file

config FIH_INFO
	bool "fih info"
	depends on FIH
	default n
	help
	  support fih info virtual file

config FIH_GPIO
	bool "fih gpio"
	depends on FIH
	default n
	help
	  support fih gpio function

config FIH_DDR
	bool "fih ddr"
	depends on FIH
	default n
	help
	  support fih ddr virtual file

config FIH_MFD
	bool "fih mfd"
	depends on FIH
	default n
	help
	  support fih mfd virtual file

config FIH_NV
	bool "fih nv"
	depends on FIH
	default n
	help
	  support fih nv function

config FIH_SUT
	bool "fih sut"
	depends on FIH
	default n
	help
	  support fih sut virtual file

config FIH_FVER
	bool "fih fver"
	depends on FIH
	default n
	help
	  support fih fver virtual file

config FIH_UFS
	bool "fih ufs"
	depends on FIH
	default n
	help
	  support fih ufs virtual file

config FIH_TOUCH
	bool "fih touch"
	depends on FIH
	default n
	help
	  support fih touch virtual file

config FIH_LOG
	bool "fih log"
	depends on FIH
	default n
	help
	  support fih log virtual file

config FIH_SAMP
	bool "fih samp"
	depends on FIH
	default n
	help
	  support fih samp virtual file

config FIH_SENSOR
	bool "fih sensor"
	depends on FIH
	default n
	help
	  support fih sensor virtual file

config FIH_HAC
	bool "fih hac"
	default n
	help
	  support fih hac virtual file

config FIH_CPU
	bool "fih cpu"
	depends on FIH
	default n
	help
	  support fih cpu virtual file

config FIH_GYRO
	bool "fih gyro"
	depends on FIH
	default n
	help
	  support fih gyro virtual file

config FIH_ALSP
	bool "fih alsp"
	depends on FIH
	default n
	help
	  support fih alsp virtual file

config FIH_BATTERY
	bool "fih battery"
	depends on FIH
	default n
	help
	  support fih battery
endmenu
```

## drivers/platform/fih/Kconfig
```kconfig
# FIH configuration options

config MACH_FIH
	bool "FIH board"
	depends on ARCH_QCOM
	help
	  Support for FIH boards.

config MACH_FIH_SDM845
	bool "FIH SDM845 boards"
	depends on ARCH_SDM845
	select MACH_FIH
	help
	  Support for FIH SDM845 boards.

menu "FIH board selection"

config MACH_FIH_RC2
	bool "FIH RC2 board"
	select MACH_FIH_SDM845
	help
	  Support for Razer Phone 2, codenamed RC2.

endmenu
```
