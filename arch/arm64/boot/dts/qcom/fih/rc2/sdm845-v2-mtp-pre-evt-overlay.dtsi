/* Pinctrl */
#include "sdm845-pinctrl-pre-evt.dtsi"
#include "pm845-pinctrl.dtsi"
#include "pmi8998-pinctrl.dtsi"
#include "pm8005-pinctrl.dtsi"

#include "sdm845-platform-pre-evt.dtsi"
#include "sdm845-pmic.dtsi"

/* Battery */
#include "battery-pre-evt.dtsi"

/* Wireless Charger - IDT,P9221 */
#include "wireless-charging-P9221-pre-evt.dtsi"

/* Touch */
#include "touch_synaptics_3708.dtsi"

/* Display */
#include "display.dtsi"

/* Haptics */
#include "vibrator.dtsi"

/* NFC */
#include "nfc_nq_nci.dtsi"

/* Audio */
#include "sdm845-audio.dtsi"

/* Flash LED */
#include "flashled-lm3644.dtsi"

/* Fingerprint */
#include "fingerprint-fpc1235.dtsi"

/* Camera */
#include "sdm845-camera-evt.dtsi"

/* Wifi */
#include "wifi-module.dtsi"

/* LED */
#include "led-lp5523-pre-evt.dtsi"

/* USB RE-DRIVER */
#include "redriver-tusb544.dtsi"
